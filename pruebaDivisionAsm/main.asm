		.ORG	0X0000
		JMP		INICIO

		.INCLUDE "division.inc"
INICIO:
		LDI		R16,HIGH(RAMEND)
		OUT		SPH,R16
		LDI		R16,LOW(RAMEND)
		OUT		SPL,R16
		;Habilitamos UART 9600,8,N,1 solo para transmitir
		LDI			R16,0
		STS			UCSR0A,R16
		LDI			R16,(1<<TXEN0)
		STS			UCSR0B,R16
		LDI			R16,(1<<UCSZ01)|(1<<UCSZ00)
		STS			UCSR0C,R16
		LDI			r16,103
		STS			UBRR0L,r16
		LDI			R16,0
		STS			UBRR0H,R16
		
		;Dato a enviar 2345 test EJEMPLO
		LDI		R17,HIGH(2345)
		LDI		R16,LOW(2345)
		MOVW	R24,R16

		;OBTENER UNIDAD DE MIL
		LDI		R17,HIGH(1000)
		LDI		R16,LOW(1000)
		MOVW	R22,R16
		CALL	DIVISION16
		MOV		R20,R24
		LDI		R18,48
		ADD		R20,R18
		CALL	ENVIO_UART
		
		MOVW	R24,R26
		;OBTENER CENTENA
		LDI		R17,HIGH(100)
		LDI		R16,LOW(100)
		MOVW	R22,R16
		CALL	DIVISION16
		MOV		R20,R24
		LDI		R18,48
		ADD		R20,R18
		CALL	ENVIO_UART

		MOVW	R24,R26
		;OBTENER DECENA
		LDI		R17,HIGH(10)
		LDI		R16,LOW(10)
		MOVW	R22,R16
		CALL	DIVISION16
		MOV		R20,R24
		LDI		R18,48
		ADD		R20,R18
		CALL	ENVIO_UART

		;OBTENER UNIDAD
		MOV		R20,R26
		ADD		R20,R18
		CALL	ENVIO_UART

VOLVER:
		RJMP	VOLVER

;TransmisiСn de dato, valor a enviar en R20 
ENVIO_UART:
		PUSH	R19
		STS		UDR0,R20
ESPERAR_TX:		
		LDS		R19, UCSR0A
		SBRS	R19,UDRE0
		RJMP	ESPERAR_TX
		POP		R19
		RET


  